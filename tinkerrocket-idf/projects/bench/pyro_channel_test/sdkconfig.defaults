## tinkerrocket-idf/projects/bench/pyro_channel_test/sdkconfig.defaults
```kconfig
CONFIG_IDF_TARGET="esp32p4"

# No power management — runs at full speed
CONFIG_PM_ENABLE=n

# FreeRTOS
CONFIG_FREERTOS_HZ=1000

# Serial
CONFIG_ESP_CONSOLE_USB_SERIAL_JTAG=y
```

## tinkerrocket-idf/projects/gpio_wire_rx/sdkconfig.defaults
```kconfig
CONFIG_IDF_TARGET="esp32s3"
CONFIG_AUTOSTART_ARDUINO=y
CONFIG_ARDUINO_DONT_DEFINE_MIN_MAX=y
CONFIG_BT_ENABLED=n
CONFIG_ESP_CONSOLE_USB_SERIAL_JTAG=y
CONFIG_FREERTOS_HZ=1000
```

## tinkerrocket-idf/projects/i2s_tx_test/sdkconfig.defaults
```kconfig
# Target
CONFIG_IDF_TARGET="esp32s3"

# Arduino
CONFIG_AUTOSTART_ARDUINO=y
CONFIG_ARDUINO_DONT_DEFINE_MIN_MAX=y

# No BLE needed for TX test
CONFIG_BT_ENABLED=n

# Serial output
CONFIG_ESP_CONSOLE_USB_SERIAL_JTAG=y

CONFIG_FREERTOS_HZ=1000
```

## tinkerrocket-idf/projects/max17205_test/sdkconfig.defaults
```kconfig
CONFIG_IDF_TARGET="esp32s3"

# Flash
CONFIG_ESPTOOLPY_FLASHSIZE_8MB=y
CONFIG_ESPTOOLPY_FLASHFREQ_80M=y

# FreeRTOS
CONFIG_FREERTOS_HZ=1000

# Partition table
CONFIG_PARTITION_TABLE_SINGLE_APP=y

# Serial
CONFIG_ESP_CONSOLE_USB_SERIAL_JTAG=y
```

## tinkerrocket-idf/projects/power_test/sdkconfig.defaults
```kconfig
CONFIG_IDF_TARGET="esp32s3"

# BLE / NimBLE
CONFIG_BT_ENABLED=y
CONFIG_BT_NIMBLE_ENABLED=y
CONFIG_BT_NIMBLE_MAX_CONNECTIONS=1
CONFIG_BT_NIMBLE_ROLE_PERIPHERAL=y
CONFIG_BT_NIMBLE_ROLE_CENTRAL=n
CONFIG_BT_NIMBLE_ROLE_OBSERVER=n
CONFIG_BT_NIMBLE_ROLE_BROADCASTER=y

# === POWER MANAGEMENT ===
CONFIG_PM_ENABLE=y
CONFIG_FREERTOS_USE_TICKLESS_IDLE=y
CONFIG_FREERTOS_IDLE_TIME_BEFORE_SLEEP=3

# BLE controller modem sleep
CONFIG_BT_CTRL_MODEM_SLEEP=y
CONFIG_BT_CTRL_MODEM_SLEEP_MODE_1=y
CONFIG_BT_CTRL_LPCLK_SEL_MAIN_XTAL=y
CONFIG_BT_CTRL_MAIN_XTAL_PU_DURING_LIGHT_SLEEP=y

# NimBLE host sleep support
CONFIG_BT_NIMBLE_SLEEP_ENABLE=y

# PHY power down during sleep
CONFIG_ESP_PHY_MAC_BB_PD=y

# Flash
CONFIG_ESPTOOLPY_FLASHSIZE_8MB=y
CONFIG_ESPTOOLPY_FLASHFREQ_80M=y

# FreeRTOS
CONFIG_FREERTOS_HZ=1000

# Serial
CONFIG_ESP_CONSOLE_USB_SERIAL_JTAG=y
```
